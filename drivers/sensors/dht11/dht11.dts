/dts-v1/;
/plugin/;

/ {
    compatible = "allwinner,sun50i";

    fragment@0 {
        target-path = "/";
        __overlay__ {
            dht11@0 {
                compatible = "dht11";
                gpios = <&pio 0 10 GPIO_ACTIVE_HIGH>; 
                status = "okay";
            };
        };
    };
};
